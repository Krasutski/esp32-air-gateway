## components/bsp/Kconfig.projbuild
```kconfig
menu "BSP Configuration"

    config GATEWAY_MODEM_PPP_APN
        string "Set MODEM APN"
        default "www"
        help
            Set APN (Access Point Name), a logical name to choose data network

    config GATEWAY_NEED_SIM_PIN
        bool "SIM PIN needed"
        default n
        help
            Enable to set SIM PIN before starting the example

    config GATEWAY_SIM_PIN
        string "Set SIM PIN"
        default "1234"
        depends on GATEWAY_NEED_SIM_PIN
        help
            Pin to unlock the SIM

    menu "UART Configuration"
        config GATEWAY_MODEM_UART_NUM
            int "UART peripheral for modem communication"
            range 1 2
            default 1
            help
                Select UART_NUM_x for modem interface

        config GATEWAY_MODEM_UART_EVENT_TASK_STACK_SIZE
            int "UART Event Task Stack Size"
            range 2000 6000
            default 4096
            help
                Stack size of UART event task.

        config GATEWAY_MODEM_UART_EVENT_TASK_PRIORITY
            int "UART Event Task Priority"
            range 3 22
            default 5
            help
                Priority of UART event task.

        config GATEWAY_MODEM_UART_EVENT_QUEUE_SIZE
            int "UART Event Queue Size"
            range 10 40
            default 40
            help
                Length of UART event queue.

        config GATEWAY_MODEM_UART_PATTERN_QUEUE_SIZE
            int "UART Pattern Queue Size"
            range 10 40
            default 20
            help
                Length of UART pattern queue.

        config GATEWAY_MODEM_UART_TX_BUFFER_SIZE
            int "UART TX Buffer Size"
            range 256 16384
            default 16384
            help
                Buffer size of UART TX buffer. Recommended 2048 for NAT applications.

        config GATEWAY_MODEM_UART_RX_BUFFER_SIZE
            int "UART RX Buffer Size"
            range 256 16384
            default 16384
            help
                Buffer size of UART RX buffer. Recommended 16384 for NAT applications.

    endmenu
endmenu
```

## main/Kconfig.projbuild
```kconfig
menu "Air Gateway AP Configuration"

    config AIR_GATEWAY_AP_WIFI_SSID
        string "Set AP WiFi SSID"
        default "air-gateway"
        help
            Set the SSID for the WiFi access point

    config AIR_GATEWAY_AP_WIFI_PASS
        string "Set AP WiFi Password"
        default "air1234567890"
        help
            Set the password for the WiFi access point

    config AIR_GATEWAY_AP_WIFI_CHANNEL
        int "Set AP WiFi Channel"
        default 1
        help
            Set the channel for the WiFi access point

    config AIR_GATEWAY_AP_MAX_STA_CONN
        int "Set Max STA Connections"
        default 4
        help
            Set the maximum number of station connections

endmenu
```
